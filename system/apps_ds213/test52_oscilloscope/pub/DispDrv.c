/********************* (C) COPYRIGHT 2018 e-Design Co.,Ltd. ********************
  DispDrv.c Ver: 2.0                                             Author : bure
*******************************************************************************/
void ClrScrn(u16 Color);
void DispPosn8x14(u16 x, u16 y);
void DispStr8x14(u16 ForeGrnd, u16 BackGrnd, u8 Mode, u32 StrBase);
void DispLogo(u16 x0, u16 y0);

uc16 FONT_8x14[] = {    // 标准字库
    0x0000,0x0000,0x0000,0x0000,0x0000,0x0000,0x0000,0x0000, // _  
    0x0000,0x0000,0x1C00,0x3F60,0x3F60,0x1C00,0x0000,0x0000, // !  
    0x0000,0x7000,0x7800,0x0000,0x0000,0x0000,0x7800,0x7000, // "  
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    0x0000,0x01C0,0x03C0,0x0640,0x0C40,0x0640,0x03C0,0x01C0,// tri 
};

/*******************************************************************************
 Clear_Screen: 清LCD显示器屏幕。
*******************************************************************************/
void ClrScrn(u16 Color)
{
  vu16 Temp = Color;
  LCD_W_Block(0, 0, COL_SIZE, ROW_SIZE);
  u32 n = COL_SIZE * ROW_SIZE;
  DMA_FILL((u32)&Temp, n);
  LCD_DmaWait();
}
/*******************************************************************************
  屏幕显示字符串  Mode: 0/1 => CHAR/INVR
*******************************************************************************/
void DispPosn8x14(u16 x, u16 y)
{
  LCD_W_Block(x, y, COL_SIZE-1, y+13);
}
/*******************************************************************************
  屏幕显示字符串  Mode: 0/1 => CHAR/INVR
*******************************************************************************/
void DispStr8x14(u16 ForeGrnd, u16 BackGrnd, u8 Mode, u32 StrBase)
{
  u8 *Str = (u8*)StrBase;
  while(*Str != 0){
    for(u16 i = 0; i < 8; ++i){
      u16 k = FONT_8x14[(*Str - ' ')*8+i];
      for(u16 j = 0; j < 14; ++j){
        if(k&4)  *pLCD_DB_W = (Mode & INVR) ? BackGrnd : ForeGrnd;
        else     *pLCD_DB_W = (Mode & INVR) ? ForeGrnd : BackGrnd;
        k >>= 1;
      }
    }
    Str++;
  }
  u8 n = 14;
  while(n--) *pLCD_DB_W = BLK;  // 字符串后增加一空白列
}
/*******************************************************************************
 Display_Logo: 在指定位置显示商标图案   输入: X、Y坐标
--------------------------------------------------------------------------------
LOGO文件格式为 16 色 64*256 的 BMP 文件，但扩展名改为 .INF
 0x00~0x09: 文件类型 2B,大小 4B, 保留 4B, 0x0A~0x0D: 文件头到实际图像数据的偏移
 0x36~0x75: 调色板(每色 4B, 顺序为 B, G, R, Alpha)
 0x0076~0x2075: 8kB, 16k 点图像数据
*******************************************************************************/
void DispLogo(u16 x0, u16 y0)
{
  u16 Color[16];
  u8 *p = (u8*)0x0807D800;//&LOGO_BASE;
  u16 x = x0+256;
  for(u16 i = 0; i < 16; i++){ // 0x36~0x75: 调色板(每色 4B, 顺序为 B, G, R, Alpha)
    Color[i] = ((p[0x36+i*4]>> 3)<< 11)+((p[0x37+i*4]>> 2)<< 5)+(p[0x38+i*4]>> 3);
  }
  p += 0x76;
  for(u16 i = 0; i < 128; i++){
    x = x0+i*2;
    LCD_Posn(x, y0);
    for(u16 j = 0; j < 64; j++) *pLCD_DB_W = Color[p[i+j*128]>> 4]; // 高半字节
    LCD_Posn(x + 1, y0);
    for(u16 j = 0; j < 64; j++) *pLCD_DB_W = Color[p[i+j*128]& 15]; // 低半字节
  }
}

/******************************** END OF FILE *********************************/
