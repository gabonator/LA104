uint8_t getfont68(char c, int i);

class CSmallFont
{
public:
    void Print(int bx, int by, const char* msg, uint16_t color)
    {
        while (*msg)
        {
            Printch(bx, by, *msg++, color);
            bx += 6;
        }
    }
    
    int FitText(char* text, int maxChars, char* line0, char* line1, char* line2)
    {
        auto TakeLine = [](char* text, int maxLength, char* output) -> int
        {
            int lastSpacer = 0;
            
            int len = (int)strlen(text);
            
            if (len < maxLength)
            {
                // fits whole text
                memcpy(output, text, len);
                output[len] = 0;
                return len;
            } else
            {
                len = maxLength;
            }
            
            for (int i=0; i<len; i++)
                if (text[i] == ' ')
                    lastSpacer = i;
            
            if (lastSpacer == 0)
            {
                // cut long word
                memcpy(output, text, maxLength);
                output[maxLength] = 0;
                return maxLength;
            }
            
            memcpy(output, text, lastSpacer);
            output[lastSpacer] = 0;
            return lastSpacer+1;
        };
        
        auto AppendDots = [](char* text, int length)
        {
            if ((int)strlen(text) < length-3)
            {
                strcat(text, "...");
                return;
            }
            strcpy(text+length-3, "...");
        };
        
        line0[0] = line1[0] = line2[0] = 0;
        
        text += TakeLine(text, maxChars, line0);
        if (strlen(text) == 0)
            return 1;
        
        text += TakeLine(text, maxChars, line1);
        if (strlen(text) == 0)
            return 2;
        
        text += TakeLine(text, maxChars, line2);
        if (strlen(text) > 0)
            AppendDots(line2, maxChars);
        return 3;
    }

private:
    void Printch(int bx, int by, char ch, uint16_t c)
    {
        if (ch == ' ')
            return;
        for (int y=0; y<8; y++)
            for (int x=0; x<6; x++)
                if (getfont68(ch, x) & (128>>y))
                    LCD::PutPixel(bx+x, by+y, c);        
    }
};



const static uint8_t CHAR6x8[] = {
    0x00, 0x00, 0xFA, 0xFA, 0x00, 0x00,    //!
    0x00, 0x00, 0xE0, 0x00, 0xE0, 0x00,    //"
    0x00, 0x28, 0xFE, 0x28, 0xFE, 0x28,    //#
    //  0x00, 0x24, 0x74, 0xD6, 0xD6, 0x4C,    //$
    0x00, 0x0C, 0x06, 0x0E, 0x18, 0x30,    //$
    0x00, 0x66, 0x6C, 0x18, 0x36, 0x66,    //%
    0x00, 0x4C, 0xFE, 0x92, 0x9E, 0x6A,    //&
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    0x00, 0x00, 0x01, 0x27, 0x26, 0x00,    //;
    //  0x00, 0x10, 0x38, 0x6C, 0xC6, 0x82,    //<
    0x00, 0x18, 0x3C, 0x7E, 0xFF, 0x00,    //
    0x00, 0x28, 0x28, 0x28, 0x28, 0x28,    //=
    //  0x00, 0x82, 0xC6, 0x6C, 0x38, 0x10,    //>
    0x00, 0xFF, 0x7E, 0x3C, 0x18, 0x00,    //
    0x00, 0x40, 0xCA, 0x9A, 0xF0, 0x60,    //?
    0x00, 0x7C, 0xFE, 0x82, 0xB2, 0x74,    //@
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    0x00, 0xC6, 0x8E, 0x9A, 0xF2, 0xE6,    //Z
    //  0x00, 0x00, 0xFE, 0x82, 0x82, 0x00,    //[
    0xFF, 0x83, 0x01, 0x7D, 0x01, 0x83,    //0
    0x00, 0x60, 0x30, 0x18, 0x0C, 0x06,    //  "\"
    //  0x00, 0x00, 0x82, 0x82, 0xFE, 0x00,    //]
    0xFF, 0xFF, 0xBD, 0x01, 0x01, 0xFD,    //1
    //  0x00, 0x30, 0x60, 0xC0, 0x60, 0x30,    //^
    0x00, 0x00, 0x2A, 0x2C, 0x28, 0x38,    //^
    0x00, 0x02, 0x02, 0x02, 0x02, 0x02,    //_
    //  0x00, 0x40, 0x70, 0x30, 0x00, 0x00,    //`
    0x28, 0x68, 0xA8, 0x28, 0x00, 0x00,    //`
    0x00, 0x04, 0x2E, 0x2A, 0x2A, 0x1E,    //a
    0x00, 0x7E, 0x7E, 0x12, 0x1E, 0x0C,    //b
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    0x00, 0x00, 0x00, 0xFE, 0x00, 0x00,    //|
    //  0x00, 0x00, 0x2A, 0x2C, 0x28, 0x38,    //{
    //  0x28, 0x68, 0xA8, 0x28, 0x00, 0x00,    //|
    0x90, 0x98, 0xFF, 0x19, 0x11, 0x00,    //
    0x00, 0x30, 0x60, 0x30, 0x18, 0x30,    //~
};

uint8_t getfont68(char c, int i) { return CHAR6x8[(c-'!')*6+i];}
